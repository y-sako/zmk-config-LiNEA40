## config/west.yml
```yaml
manifest:
  remotes:
    - name: cormoran
      url-base: https://github.com/cormoran
    - name: inorichi
      url-base: https://github.com/inorichi
    - name: caksoylar
      url-base: https://github.com/caksoylar
  projects:
    - name: zmk
      remote: cormoran
      revision: v0.3-branch+dya
      import: app/west.yml
    - name: zmk-module-ble-management
      remote: cormoran
      revision: 851661cd21f2aded8ec649da86e01a207dc4b973
    - name: zmk-module-battery-history
      remote: cormoran
      revision: main
    - name: zmk-module-settings-rpc
      remote: cormoran
      revision: main
    - name: zmk-module-runtime-input-processor
      remote: cormoran
      revision: dbf92f764de8b6ffd60bf5850514302875fe2570
    - name: zmk-behavior-runtime-sensor-rotate
      remote: cormoran
      revision: main
    - name: zmk-feature-custom-settings
      remote: cormoran
      revision: main
    - name: zmk-feature-runtime-combo
      remote: cormoran
      revision: main
    - name: zmk-pmw3610-driver
      remote: inorichi
      revision: main
    - name: zmk-rgbled-widget
      remote: caksoylar
      revision: v0.3
  self:
    path: config
```
